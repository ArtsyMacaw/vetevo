## sdkconfig.defaults
```kconfig
# Enable ULP and set max memory
CONFIG_ULP_COPROC_ENABLED=y
CONFIG_ULP_COPROC_RESERVE_MEM=8176
CONFIG_ULP_COPROC_TYPE_RISCV=y
# Use higher flash frequency and QIO mode for faster flash access
CONFIG_ESPTOOLPY_FLASHFREQ_80M=y
CONFIG_ESPTOOLPY_FLASHFREQ="80m"
CONFIG_ESPTOOLPY_FLASHMODE_QIO=y
CONFIG_ESPTOOLPY_FLASHMODE="qio"
# RTC clock source
CONFIG_RTC_CLK_SRC_INT_8MD256=y
# Set CPU frequency to 80 MHz for lower power consumption
ESP_DEFAULT_CPU_FREQ_MHZ_80=y
```
